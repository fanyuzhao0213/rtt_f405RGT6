#include"oled.h"

#define OLED_I2C_BUS_NAME          "i2c2"  /* 传感器连接的I2C总线设备名称 */
static rt_uint32_t MyOledThreadInit_stack = 1024;
struct rt_i2c_bus_device *oled_i2c_bus;      /* I2C总线设备句柄 */
	
	
const rt_uint8_t F6x8[][6] =
{
0x00, 0x00, 0x00, 0x00, 0x00, 0x00,//sp
0x00, 0x00, 0x00, 0x2f, 0x00, 0x00,// !
0x00, 0x00, 0x07, 0x00, 0x07, 0x00,// "
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0x14, 0x14, 0x14, 0x14, 0x14, 0x14,// horiz lines
};
/****************************************8*16µÄµãÕó************************************/
const rt_uint8_t F8X16[]=
{
  0x00,0x00,0x00,0x00,0x00,0x00,0x00,0x00,0x00,0x00,0x00,0x00,0x00,0x00,0x00,0x00,// 0
  0x00,0x00,0x00,0xF8,0x00,0x00,0x00,0x00,0x00,0x00,0x00,0x33,0x30,0x00,0x00,0x00,//! 1
  0x00,0x10,0x0C,0x06,0x10,0x0C,0x06,0x00,0x00,0x00,0x00,0x00,0x00,0x00,0x00,0x00,//" 2
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  0x00,0x06,0x01,0x01,0x02,0x02,0x04,0x04,0x00,0x00,0x00,0x00,0x00,0x00,0x00,0x00,//~ 94
};
char Hzk[][32]={

{0x00,0x00,0xF0,0x10,0x10,0x10,0x10,0xFF,0x10,0x10,0x10,0x10,0xF0,0x00,0x00,0x00},
{0x00,0x00,0x0F,0x04,0x04,0x04,0x04,0xFF,0x04,0x04,0x04,0x04,0x0F,0x00,0x00,0x00},/*"ÖÐ",0*/

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{0x00,0x00,0xFF,0x02,0x01,0x1E,0x12,0x12,0x12,0x1E,0x41,0x82,0x7F,0x00,0x00,0x00},/*"ÉÌ",6*/

/*-- ID:0,字符:"我",ASCII编码:CED2,对应字:宽x高=16x16,画布:宽W=16 高H=16,共32字节*/
{0x20,0x24,0x24,0x24,0xfe,0x23,0x22,0x20,0xff,0x20,0x22,0xac,0x20,0x30,0x20,0x00},
{0x00,0x08,0x48,0x84,0x7f,0x02,0x21,0x10,0x09,0x06,0x1a,0x61,0x80,0xe0,0x00,0x00},

/*-- ID:1,字符:"是",ASCII编码:CAC7,对应字:宽x高=16x16,画布:宽W=16 高H=16,共32字节*/
{0x00,0x00,0x00,0x00,0x7f,0x49,0x49,0x49,0x49,0x49,0x7f,0x00,0x00,0x80,0x00,0x00},
{0x01,0x81,0x41,0x21,0x1d,0x21,0x41,0x7f,0x89,0x89,0x8d,0x89,0x81,0xc1,0x41,0x00},

/*-- ID:2,字符:"冉",ASCII编码:C8BD,对应字:宽x高=16x16,画布:宽W=16 高H=16,共32字节*/
{0x00,0x00,0xf8,0x48,0x48,0x48,0x48,0xff,0x48,0x48,0x48,0x48,0xfc,0x08,0x00,0x00},
{0x02,0x02,0xff,0x02,0x02,0x02,0x02,0x03,0x02,0x02,0x42,0x82,0x7f,0x02,0x02,0x00},

/*-- ID:3,字符:"东",ASCII编码:B6AB,对应字:宽x高=16x16,画布:宽W=16 高H=16,共32字节*/
{0x08,0x08,0x08,0x88,0x68,0x18,0x0f,0xe8,0x08,0x08,0x08,0x88,0x08,0x0c,0x08,0x00},
{0x00,0x40,0x21,0x11,0x0d,0x41,0x81,0x7f,0x01,0x05,0x09,0x31,0x61,0x00,0x00,0x00},

/*-- ID:4,字符:"辉",ASCII编码:BBD4,对应字:宽x高=16x16,画布:宽W=16 高H=16,共32字节*/
{0x44,0x48,0xd0,0x7f,0xd0,0x4c,0x48,0xa6,0x62,0x3a,0xa2,0x22,0x32,0x26,0x02,0x00},
{0x40,0x30,0x0f,0x00,0x3f,0x10,0x08,0x09,0x09,0x09,0xff,0x09,0x09,0x0d,0x08,0x00},
};


void OLED_Init(struct rt_i2c_bus_device *bus)
{
    rt_thread_mdelay(300);
    write_reg(bus,Command_ADDR,0xAE);
    write_reg(bus,Command_ADDR,0x40);
    write_reg(bus,Command_ADDR,0xB0);
    write_reg(bus,Command_ADDR,0xC8);
    write_reg(bus,Command_ADDR,0x81);
    write_reg(bus,Command_ADDR,0xff);
    write_reg(bus,Command_ADDR,0xa1);
    write_reg(bus,Command_ADDR,0xa6);
    write_reg(bus,Command_ADDR,0xa8);
    write_reg(bus,Command_ADDR,0x1f);
    write_reg(bus,Command_ADDR,0xd3);
    write_reg(bus,Command_ADDR,0x00);
    write_reg(bus,Command_ADDR,0xd5);
    write_reg(bus,Command_ADDR,0xf0);
    write_reg(bus,Command_ADDR,0xd9);
    write_reg(bus,Command_ADDR,0x22);
    write_reg(bus,Command_ADDR,0xda);
    write_reg(bus,Command_ADDR,0x02);
    write_reg(bus,Command_ADDR,0xdb);
    write_reg(bus,Command_ADDR,0x49);
    write_reg(bus,Command_ADDR,0x8d);
    write_reg(bus,Command_ADDR,0x14);
    write_reg(bus,Command_ADDR,0xaf);
    OLED_Clear(bus);
}

//清屏
void OLED_Clear(struct rt_i2c_bus_device *bus)
{

    rt_uint8_t i,n;
    for(i=0;i<8;i++)
    {
        write_reg(bus,Command_ADDR,0xb0+i);
        write_reg(bus,Command_ADDR,0x00);
        write_reg(bus,Command_ADDR,0x10);
        for(n=0;n<128;n++) write_reg(bus,Data_ADDR,0);
    }
}

//坐标设置
void OLED_Set_Pos(struct rt_i2c_bus_device *bus,rt_uint8_t x,rt_uint8_t y)
{
    write_reg(bus,Command_ADDR,0xb0+y);
    write_reg(bus,Command_ADDR,((x&0xf0)>>4)|0x10);
    write_reg(bus,Command_ADDR,(x&0x0f));
}

//开启OLED显示
void OLED_Display_On(struct rt_i2c_bus_device *bus)
{
    write_reg(bus,Command_ADDR,0x8D);
    write_reg(bus,Command_ADDR,0x14);
    write_reg(bus,Command_ADDR,0xAF);
}

//关闭OLED显示
void OLED_Display_Off(struct rt_i2c_bus_device *bus)
{
    write_reg(bus,Command_ADDR,0x8D);
    write_reg(bus,Command_ADDR,0x10);
    write_reg(bus,Command_ADDR,0xAE);
}

void OLED_On(struct rt_i2c_bus_device *bus)
{
    rt_uint8_t i,n;
    for(i=0;i<8;i++)
    {
        write_reg(bus,Command_ADDR,0xb0+i);
        write_reg(bus,Command_ADDR,0x00);
        write_reg(bus,Command_ADDR,0x10);
        for(n=0;n<128;n++) write_reg(bus,Data_ADDR,1);
    }
}

//显示字符
void OLED_ShowChar(struct rt_i2c_bus_device *bus,rt_uint8_t x,rt_uint8_t y,rt_uint8_t chr,rt_uint8_t Char_Size)
{
    rt_uint8_t c=0,i=0;
    c=chr-' ';
    if(x>Max_Column-1){x=0;y=y+2;}
    if(Char_Size ==16)
    {
        OLED_Set_Pos(bus,x,y);
        for(i=0;i<8;i++)
            write_reg(bus,Data_ADDR,F8X16[c*16+i]);
        OLED_Set_Pos(bus,x,y+1);
        for(i=0;i<8;i++)
            write_reg(bus,Data_ADDR,F8X16[c*16+i+8]);
    }
    else {
        OLED_Set_Pos(bus,x,y);
        for(i=0;i<6;i++)
            write_reg(bus,Data_ADDR,F6x8[c][i]);
    }
}

//m^n函数
rt_uint32_t OLED_pow(rt_uint8_t m,rt_uint8_t n)
{
    rt_uint32_t result=1;
    while(n--)result*=m;
    return result;
}

//显示数字
void OLED_ShowNum(struct rt_i2c_bus_device *bus,rt_uint8_t x,rt_uint8_t y,rt_uint32_t num,rt_uint8_t len,rt_uint8_t size2)
{
    rt_uint8_t t,temp;
    rt_uint8_t enshow=0;
    for(t=0;t<len;t++)
    {
        temp=(num/OLED_pow(10,len-t-1))%10;
        if(enshow==0&&t<(len-1))
        {
            if(temp==0)
            {
                OLED_ShowChar(bus,x+(size2/2)*t,y,' ',size2);
                continue;
            }else enshow=1;

        }
        OLED_ShowChar(bus,x+(size2/2)*t,y,temp+'0',size2);
    }
}

//显示字符串
void OLED_ShowString(struct rt_i2c_bus_device *bus,rt_uint8_t x,rt_uint8_t y,rt_uint8_t *chr,rt_uint8_t Char_Size)
{
    rt_uint8_t j=0;
    while (chr[j]!='\0')
    {       OLED_ShowChar(bus,x,y,chr[j],Char_Size);
            x+=8;
        if(x>120){x=0;y+=2;}
            j++;
    }
}

//显示汉字
void OLED_ShowCHinese(struct rt_i2c_bus_device *bus,rt_uint8_t x,rt_uint8_t y,rt_uint8_t no)
{
    rt_uint8_t t,adder=0;
    OLED_Set_Pos(bus,x,y);
    for(t=0;t<16;t++)
     {
            write_reg(bus,Data_ADDR,Hzk[2*no][t]);
            adder+=1;
     }
        OLED_Set_Pos(bus,x,y+1);
    for(t=0;t<16;t++)
    {
        write_reg(bus,Data_ADDR,Hzk[2*no+1][t]);
        adder+=1;
    }
}

/* 写传感器寄存器 */
rt_err_t write_reg(struct rt_i2c_bus_device *bus, rt_uint8_t reg, rt_uint8_t data)
{
    rt_uint8_t buf[2];
    struct rt_i2c_msg msgs;
    buf[0] = reg; //cmd
    buf[1] = data;
    msgs.addr = OLED_ADDR;
    msgs.flags = RT_I2C_WR;
    msgs.buf = buf;
    msgs.len = 2;

    /* 调用I2C设备接口传输数据 */
    if (rt_i2c_transfer(bus, &msgs, 1) == 1)
    {
        return RT_EOK;
    }
    else
    {
        return -RT_ERROR;
    }
}

void oled_test_func(void)
{
	char *buf = "hello world!";
	char *buf2 = "oled_temp:";
	char *buf3 = 0;
	rt_sprintf(buf3,"%s%d",buf2,10);
//	OLED_ShowString(oled_i2c_bus,0,8,(rt_uint8_t *)buf,rt_strlen(buf));
//	OLED_Clear(oled_i2c_bus);
	OLED_ShowString(oled_i2c_bus,8,8,(rt_uint8_t *)buf2,rt_strlen(buf2));
}
	
/*oled 线程入口函数*/
void MyOledThreadInitThread(void *parameter)
{
	rt_uint8_t pin1 = GET_PIN(A, 9);
	rt_uint8_t pin2 = GET_PIN(A, 10);
	rt_kprintf("pin1:%d,pin2:%d\n", pin1,pin2);
	
    oled_i2c_bus = (struct rt_i2c_bus_device *)rt_device_find(OLED_I2C_BUS_NAME);  /* 查找I2C总线设备，获取I2C总线设备句柄 */
    if (oled_i2c_bus == RT_NULL)
    {
        rt_kprintf("iic sample run failed! can't find %s device!\n", OLED_I2C_BUS_NAME);
    }else{
		rt_kprintf("iic oled run successs! find %s device!\n", OLED_I2C_BUS_NAME);
	}
	SendEvent(EVENT_FLAG_MyOledThreadInit);
    WaitForThreadSync();
	
	rt_kprintf("The currrent Thread is %s!\n", "MyOledThreadInitThread");
    OLED_Init(oled_i2c_bus);
    OLED_Clear(oled_i2c_bus);
	while(1)
	{
		oled_test_func();
		rt_thread_mdelay(100);
	}
}

void MyOledThreadInit(rt_uint8_t ThreadPriority, rt_uint32_t ThreadTick)
{
	    /* 定义线程句柄 */
    rt_thread_t tid;
 
    /* 创建动态pin线程 ：优先级 25 ，时间片 5个系统滴答，线程栈512字节 */
    tid = rt_thread_create("oled_thread",
                  MyOledThreadInitThread,
                  RT_NULL,
                  MyOledThreadInit_stack,
                  ThreadPriority,
                  ThreadTick);
 
    /* 创建成功则启动动态线程 */
    if (tid != RT_NULL)
    {
		rt_kprintf("thread  MyOledThreadInit  start success!!\n");
    	rt_thread_startup(tid);
	}

}

